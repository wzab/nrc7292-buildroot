## br2_ext/Config.in
```kconfig
source "$BR2_EXTERNAL_WZAB_PATH/package/nrc-module/Config.in"
source "$BR2_EXTERNAL_WZAB_PATH/package/cli-app/Config.in"
```

## br2_ext/package/cli-app/Config.in
```kconfig
config BR2_PACKAGE_CLI_APP
	bool "cli-app"
	depends on BR2_TOOLCHAIN_HAS_THREADS
	depends on BR2_PACKAGE_NRC_MODULE
	help
	  Client application for NRC7292

	  https://github.com/newracom/nrc7292_sw_pkg.git

comment "cli_app depends on nrc-module"
	depends on !BR2_PACKAGE_NRC_MODULE

comment "cli_app depends on threads support"
	depends on !BR2_TOOLCHAIN_HAS_THREADS
```

## br2_ext/package/nrc-module/Config.in
```kconfig
config BR2_PACKAGE_NRC_MODULE
	bool "nrc-module"
	depends on BR2_LINUX_KERNEL
	help
          NRC7292 kernel driver

          https://github.com/wzab/nrc7292_sw_pkg.git

comment "nrc-module needs a Linux kernel to be built"
	depends on !BR2_LINUX_KERNEL
```
